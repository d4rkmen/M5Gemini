## main/Kconfig.projbuild
```kconfig
menu "HAL Configuration"

    choice BOARD
        prompt "Target board"
        default BOARD_CARDPUTER

        config BOARD_CARDPUTER
            bool "M5Cardputer / M5Cardputer ADV"

        config BOARD_STICKS3
            bool "M5StickS3"
            help
                Two buttons instead of a keyboard, no SD card and no RGB LED.
                Disable "Enable SD card" and "Enable RGB LED" for this board.
    endchoice

    config HAL_USE_I2C
        bool "Enable I2C master"
        default y

    config HAL_USE_DISPLAY
        bool "Enable display (LovyanGFX)"
        default y

    config HAL_USE_KEYBOARD
        bool "Enable keyboard"
        default y
        depends on HAL_USE_I2C

    config HAL_USE_SPEAKER
        bool "Enable speaker (I2S audio)"
        default y

    config HAL_USE_MIC
        bool "Enable microphone (I2S input)"
        default y

    config HAL_USE_LED
        bool "Enable RGB LED (WS2812)"
        default y

    config HAL_USE_BUTTON
        bool "Enable button input"
        default y

    config HAL_USE_BAT
        bool "Enable battery monitoring"
        default y

    config HAL_USE_SDCARD
        bool "Enable SD card"
        default y

    config HAL_USE_WIFI
        bool "Enable WiFi"
        default y

endmenu
```
